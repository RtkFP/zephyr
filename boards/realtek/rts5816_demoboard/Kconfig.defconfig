## boards/realtek/rts5816_demoboard/Kconfig.defconfig
```kconfig
# Copyright (c) 2024 Realtek Semiconductor, Inc.
# SPDX-License-Identifier: Apache-2.0

if BOARD_RTS5816_DEMOBOARD

config BOARD
	default "rts5816_demoboard"

endif
```

## boards/realtek/rts5816_demoboard/Kconfig.rts5816_demoboard
```kconfig
# Copyright (c) 2024 Realtek Semiconductor, Inc.
# SPDX-License-Identifier: Apache-2.0

config BOARD_RTS5816_DEMOBOARD
	select SOC_RTS5816
```

## boards/realtek/rts5817_maa_evb/Kconfig.defconfig
```kconfig
# Copyright (c) 2024 Realtek Semiconductor, Inc.
# SPDX-License-Identifier: Apache-2.0

if BOARD_RTS5817_MAA_EVB

config BOARD
	default "rts5817_maa_evb"

endif
```

## boards/realtek/rts5817_maa_evb/rts5817_maa_evb_defconfig
```kconfig
# Copyright (c) 2025 Realtek Semiconductor, Inc.
# SPDX-License-Identifier: Apache-2.0

# Enable clocks
CONFIG_CLOCK_CONTROL=y

# Enable reset
CONFIG_RESET=y

# Enable serial console
CONFIG_SERIAL=y
CONFIG_CONSOLE=y
CONFIG_UART_CONSOLE=y

# Enable gpio
CONFIG_GPIO=y

# Enable watchdog
CONFIG_WATCHDOG=y
CONFIG_WDT_DISABLE_AT_BOOT=y

# Enable flash
CONFIG_FLASH=y

# Enable regulator
CONFIG_REGULATOR=y

# Enable SPI
CONFIG_SPI=y
CONFIG_SPI_ASYNC=y
CONFIG_HEAP_MEM_POOL_SIZE=32768

# Enable USB device
CONFIG_UDC_DRIVER=y
CONFIG_USB_DEVICE_STACK_NEXT=y

# Enable entropy
CONFIG_ENTROPY_GENERATOR=y
```

## drivers/clock_control/Kconfig.rts5816
```kconfig
# Copyright (c) 2024 Realtek Semiconductor, Inc.
# SPDX-License-Identifier: Apache-2.0

config CLOCK_CONTROL_RTS5816
	bool "RTS5816 clock control"
	depends on DT_HAS_REALTEK_RTS5816_CLOCK_ENABLED
	default y
	help
	  Enable driver for RTS5816 Clock Control.
```

## drivers/entropy/Kconfig.rts5816
```kconfig
# Copyright (c) 2024 Realtek Semiconductor, Inc.
# SPDX-License-Identifier: Apache-2.0

config ENTROPY_RTS5816
	bool "RTS5816 Entropy Controller Driver"
	depends on DT_HAS_REALTEK_RTS5816_TRNG_ENABLED
	select ENTROPY_HAS_DRIVER
	default y
	help
	  This option enables the entropy number generator for RTS5816 SoCs.
```

## drivers/entropy/Kconfig.rts5817
```kconfig
# Copyright (c) 2024 Realtek Semiconductor, Inc.
# SPDX-License-Identifier: Apache-2.0

config ENTROPY_RTS5817
	bool "RTS5817 Entropy Controller Driver"
	depends on DT_HAS_REALTEK_RTS5817_TRNG_ENABLED
	select ENTROPY_HAS_DRIVER
	default y
	help
	  This option enables the entropy number generator for RTS5817 SoCs.
```

## drivers/flash/Kconfig.rts5816
```kconfig
# Copyright (c) 2024 Realtek Semiconductor, Inc.
# SPDX-License-Identifier: Apache-2.0

config FLASH_RTS5816_QSPI
	bool "RTS5816 flash driver"
	depends on DT_HAS_REALTEK_RTS5816_QSPI_ENABLED
	default y
	select FLASH_HAS_PAGE_LAYOUT
	select FLASH_HAS_EXPLICIT_ERASE
	help
	  Enable RTS5816 Flash driver.
```

## drivers/flash/Kconfig.rts5817
```kconfig
# Copyright (c) 2025 Realtek Semiconductor, Inc.
# SPDX-License-Identifier: Apache-2.0

config FLASH_RTS5817_QSPI
	bool "RTS5817 flash driver"
	depends on DT_HAS_REALTEK_RTS5817_QSPI_ENABLED
	default y
	select FLASH_HAS_PAGE_LAYOUT
	select FLASH_HAS_EXPLICIT_ERASE
	select FLASH_HAS_EX_OP
	help
	  Enable RTS5817 Flash driver.

if FLASH_RTS5817_QSPI

choice
	prompt "Read mode for RTS5817"
	default FLASH_RTS5817_READ_MODE_QUAD
	help
	  Select read mode for RTS5817. RTS5817 supports single(1-1-1), dual(1-1-2)
	  and quad(1-1-4) read modes. Default is quad read mode.

config FLASH_RTS5817_READ_MODE_SINGLE
	bool "Flash single(1-1-1) read mode"
	help
	  Select single(1-1-1) read mode.

config FLASH_RTS5817_READ_MODE_DUAL
	bool "Flash dual(1-1-2) read mode"
	help
	  Select dual(1-1-2) read mode.

config FLASH_RTS5817_READ_MODE_QUAD
	bool "Flash quad(1-1-2) read mode"
	help
	  Select quad(1-1-4) read mode.

endchoice

config FLASH_RTS5817_WRITE_PROTECTION_AUTO
	bool "flash write protection auto control"
	depends on !FLASH_EX_OP_ENABLED
	default y
	help
	  Configure whether to control flash write protection automatically.
	  Default is y, so write protection is disabled automatically before
	  writing or erasing, and enabled after operation. If n is selected,
	  write protection is manipulated by extra operation, which means
	  FLASH_EX_OP_ENABLED needs to set y.

config FLASH_RTS5817_WP_CTRL
	bool "flash WP# pin control"
	depends on !FLASH_RTS5817_READ_MODE_QUAD
	depends on FLASH_EX_OP_ENABLED
	help
	  Configure whether to control the WP# pin of the SPI NOR flash. It depends
	  on FLASH_EX_OP_ENABLED.

endif
```

## drivers/gpio/Kconfig.rts5816
```kconfig
# Copyright (c) 2024 Realtek Semiconductor, Inc.
# SPDX-License-Identifier: Apache-2.0

config GPIO_RTS5816
	bool "RTS5816 gpio driver"
	depends on DT_HAS_REALTEK_RTS5816_GPIO_ENABLED
	default y
	help
	  Enable driver for RTS5816 gpio.
```

## drivers/pinctrl/Kconfig.rts5816
```kconfig
# Copyright (c) 2024 Realtek Semiconductor, Inc.
# SPDX-License-Identifier: Apache-2.0

config PINCTRL_RTS5816
	bool "RTS5816 pin controller driver"
	default y
	depends on DT_HAS_REALTEK_RTS5816_PINCTRL_ENABLED
	help
	  Enable driver for RTS5816 pin controller.
```

## drivers/regulator/Kconfig.rts5816
```kconfig
# Copyright (c) 2024 Realtek Semiconductor, Inc.
# SPDX-License-Identifier: Apache-2.0

config REGULATOR_RTS5816
	bool "RTS5816 Regulator Driver"
	default y
	depends on DT_HAS_REALTEK_RTS5816_REGULATOR_ENABLED
	help
	  This option enables the regulator driver for RTS5816.

if REGULATOR_RTS5816

config REGULATOR_RTS5816_INIT_PRIORITY
	int "RTS5816 regulator driver init priority"
	default 80
	help
	  Init priority for the RTS5816 regulator driver.

endif
```

## drivers/reset/Kconfig.rts5816
```kconfig
# Copyright (c) 2024 Realtek Semiconductor, Inc.
# SPDX-License-Identifier: Apache-2.0

config RESET_RTS5816
	bool "RTS5816 Reset Controller Driver"
	default y
	depends on DT_HAS_REALTEK_RTS5816_RESET_ENABLED
	help
	  This option enables the reset controller driver for RTS5816.
```

## drivers/spi/Kconfig.rts5816
```kconfig
# Copyright (c) 2024 Realtek Semiconductor, Inc.
# SPDX-License-Identifier: Apache-2.0

config SPI_RTS5816
	bool "RTS5816 SPI Controller Driver"
	depends on HEAP_MEM_POOL_SIZE > 0
	depends on DT_HAS_REALTEK_RTS5816_SPI_ENABLED
	default y
	help
	  This option enables the spi controller driver for RTS5816.
	  Please note that driver uses dynamic memory allocation with
	  k_aligned_alloc(), so CONFIG_HEAP_MEM_POOL_SIZE should be
	  >= maximum spi buffer size according to your application.
```

## drivers/usb/udc/Kconfig.rts5816
```kconfig
# Copyright (c) 2024 Realtek Semiconductor, Inc.
# SPDX-License-Identifier: Apache-2.0

config UDC_RTS5816
	bool "RTS5816 UDC driver"
	default y
	depends on DT_HAS_REALTEK_RTS5816_USBD_ENABLED
	help
	  Enable driver for RTS5816 USB.

if UDC_RTS5816

config UDC_RTS5816_THREAD_PRIORITY
	int "rts5816 usb controller driver thread priority"
	depends on UDC_RTS5816
	default 8
	help
	  RTS5816 device controller driver thread priority.

config UDC_RTS_MAX_QMESSAGES
	int "UDC RTS maximum number of ISR event messages"
	range 4 64
	default 8
	help
	  RTS maximum number of ISR event messages.

config UDC_RTS5816_STACK_SIZE
	int "UDC driver internal thread stack size"
	depends on UDC_RTS5816
	default 1024
	help
	  RTS UDC driver internal thread stack size.

config NET_BUF_ALIGNMENT
	int "Network buffer alignment restriction"
	default 32
	help
	  RTS5816 UDC driver requires DMA alignment for bulk out buffer.

endif	# UDC_RTS5816
```

## drivers/watchdog/Kconfig.rts5816
```kconfig
# Copyright (c) 2024 Realtek Semiconductor, Inc.
# SPDX-License-Identifier: Apache-2.0

config WDT_RTS5816
	bool "Realtek RTS5816 Watchdog driver"
	default y
	depends on DT_HAS_REALTEK_RTS5816_WATCHDOG_ENABLED
	select HAS_WDT_DISABLE_AT_BOOT
	help
	  Realtek RTS5816 watchdog driver.
```

## dts/bindings/clock/realtek,rts5816-clock.yaml
```yaml
# Copyright (c) 2024 Realtek Semiconductor, Inc.
# SPDX-License-Identifier: Apache-2.0

description: Realtek RTS5816 clock

compatible: "realtek,rts5816-clock"

include: [clock-controller.yaml, base.yaml]

properties:
  reg:
    required: true

  "#clock-cells":
    const: 1

clock-cells:
  - clkid
```

## dts/bindings/flash_controller/realtek,rts5816-qspi.yaml
```yaml
# Copyright (c) 2024 Realtek Semiconductor, Inc.
# SPDX-License-Identifier: Apache-2.0

description: Realtek RTS5816 flash controller

compatible: "realtek,rts5816-qspi"

include: [base.yaml]

properties:
  reg:
    required: true
```

## dts/bindings/flash_controller/realtek,rts5817-qspi.yaml
```yaml
# Copyright (c) 2025 Realtek Semiconductor, Inc.
# SPDX-License-Identifier: Apache-2.0

description: Realtek RTS5817 flash controller

compatible: "realtek,rts5817-qspi"

include: flash-controller.yaml
```

## dts/bindings/pinctrl/realtek,rts5816-pinctrl.yaml
```yaml
# Copyright (c) 2024 Realtek Semiconductor, Inc.
# SPDX-License-Identifier: Apache-2.0

description: |
  Realtek RTS5816 series pin controller

compatible: "realtek,rts5816-pinctrl"

include: base.yaml

child-binding:
  description: RTS5816 pin controller pin group.
  child-binding:
    description: RTS5816 pin controller pin mux and configuration.

    include:
      - name: pincfg-node.yaml
        property-allowlist:
          - bias-disable
          - bias-pull-down
          - bias-pull-up
          - input-enable
          - output-enable
          - drive-strength
          - power-source

    properties:
      pinmux:
        required: true
        type: array
        description: |
          An array of pins sharing the same group properties. Must
          encode all the pin muxing information in a 32-bit value.
```

## dts/bindings/reset/realtek,rts5816-reset.yaml
```yaml
# Copyright (c) 2024 Realtek Semiconductor, Inc.
# SPDX-License-Identifier: Apache-2.0

description: Realtek RTS5816 Peripheral reset controller

compatible: "realtek,rts5816-reset"

include: [reset-controller.yaml, base.yaml]

properties:
  "#reset-cells":
    const: 1

reset-cells:
  - id
```

## dts/bindings/spi/realtek,rts5816-spi.yaml
```yaml
# Copyright (c) 2024 Realtek Semiconductor, Inc.
# SPDX-License-Identifier: Apache-2.0

description: Realtek RTS5816 SPI node

compatible: "realtek,rts5816-spi"

include: [spi-controller.yaml, pinctrl-device.yaml]

properties:
  reg:
    required: true

  clocks:
    required: true

  interrupt-enable:
    type: boolean
    description: |
      Spi works on interrupt mode if true, so asynchronous
      mode is supported

  serial-target:
    type: boolean
    description: |
      True if it is a Serial Target. False if it is a Serial
      Master. Corresponds to SSI_IS_MASTER of the Designware
      Synchronous Serial Interface.

  max-xfer-size:
    type: int
    description: |
      Maximum transfer size. Corresponds to SPI_MAX_XFER_SIZE
      of the DesignWare Synchronous Serial Interface. Only
      values of 16 and 32 are supported.
    enum:
      - 16
      - 32
```

## dts/bindings/usb/realtek,rts5816-usbd.yaml
```yaml
# Copyright (c) 2024 Realtek Semiconductor, Inc.
# SPDX-License-Identifier: Apache-2.0

description: |
  RTS5816 usb device controller

compatible: "realtek,rts5816-usbd"

include: usb-ep.yaml

properties:
  reg:
    required: true

  interrupts:
    required: true

  num-endpoints:
    type: int
    required: true
    description: |
      Number of endpoints supported by hardware
      (including EP0)
```
