/*
 * Copyright (c) 2024 Realtek Semiconductor, Inc.
 * SPDX-License-Identifier: Apache-2.0
 */

#include <realtek/rts5816/rts5816_base.dtsi>

/ {
	chosen {
		zephyr,flash = &flash0;
	};

	flash0: memory@1800000 {
		compatible = "soc-nv-flash";
		reg = <0x1800000 DT_SIZE_K(121)>;
	};
};
